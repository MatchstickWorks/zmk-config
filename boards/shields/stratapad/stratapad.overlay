/ {
    chosen {
        zmk,kscan = &kscan0;
    };

	kscan0: kscan {
		compatible = "zmk,kscan-gpio-direct";
		wakeup-source;
		input-gpios
    		= <&xiao_d  1 (GPIO_ACTIVE_LOW | GPIO_PULL_UP)>
    		, <&xiao_d  5 (GPIO_ACTIVE_LOW | GPIO_PULL_UP)>
    		, <&xiao_d  7 (GPIO_ACTIVE_LOW | GPIO_PULL_UP)>
    		, <&xiao_d  2 (GPIO_ACTIVE_LOW | GPIO_PULL_UP)>
    		, <&xiao_d 14 (GPIO_ACTIVE_LOW | GPIO_PULL_UP)>
    		;
	};
};