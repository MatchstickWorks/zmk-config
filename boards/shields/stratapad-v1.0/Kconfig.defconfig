## boards/shields/stratapad-v1.0/Kconfig.defconfig
```kconfig
if SHIELD_STRATAPAD-V1.0

config ZMK_KEYBOARD_NAME
    default "StrataPad-v1.0"

config ZMK_USB
    default y

endif
```

## boards/shields/stratapad-v1.0/Kconfig.shield
```kconfig
config SHIELD_STRATAPAD-V1.0
       def_bool $(shields_list_contains,stratapad-v1.0)
```

## boards/shields/stratapad-v1.1/Kconfig.defconfig
```kconfig
if SHIELD_STRATAPAD-V1.1

config ZMK_KEYBOARD_NAME
    default "StrataPad v1.1"

config ZMK_USB
    default y

endif
```

## boards/shields/stratapad-v1.1/Kconfig.shield
```kconfig
config SHIELD_STRATAPAD-V1.1
       def_bool $(shields_list_contains,stratapad-v1.1)
```

## boards/shields/stratapad-v10/Kconfig.defconfig
```kconfig
if SHIELD_STRATAPAD-V10

config ZMK_KEYBOARD_NAME
    default "StrataPad-v1.0"

config ZMK_USB
    default y

endif
```

## boards/shields/stratapad-v10/Kconfig.shield
```kconfig
config SHIELD_STRATAPAD-V10
       def_bool $(shields_list_contains,stratapad-v10)
```

## boards/shields/stratapad-v11/Kconfig.defconfig
```kconfig
if SHIELD_STRATAPAD-V11

config ZMK_KEYBOARD_NAME
    default "StrataPad-v1.1"

config ZMK_USB
    default y

endif
```

## boards/shields/stratapad-v11/Kconfig.shield
```kconfig
config SHIELD_STRATAPAD-V11
       def_bool $(shields_list_contains,stratapad-v11)
```

## boards/shields/stratapad/Kconfig.defconfig
```kconfig
if SHIELD_STRATAPAD

config ZMK_KEYBOARD_NAME
    default "StrataPad"

config ZMK_USB
    default y

endif
```
